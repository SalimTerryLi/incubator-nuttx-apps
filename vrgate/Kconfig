## vrgate/test/Kconfig
```kconfig
#
# For a description of the syntax of this configuration file,
# see the file kconfig-language.txt in the NuttX tools repository.
#

config VRGATE_TEST
	tristate "\"VRGATE\" test"
	default y
	---help---
		Enable the \"VRGATE\" test

if VRGATE_VRGATE

config VRGATE_TEST_PROGNAME
	string "Program name"
	default "test"
	---help---
		This is the name of the program that will be used when the NSH ELF
		program is installed.

config VRGATE_TEST_PRIORITY
	int "VRGATE_VRGATE task priority"
	default 100

config VRGATE_TEST_STACKSIZE
	int "VRGATE_VRGATE stack size"
	default DEFAULT_TASK_STACKSIZE

endif
```

## vrgate/vrgate/Kconfig
```kconfig
#
# For a description of the syntax of this configuration file,
# see the file kconfig-language.txt in the NuttX tools repository.
#

config VRGATE_VRGATE
	tristate "\"VRGATE\" main"
	default n
	---help---
		Enable the \"VRGATE\" main

if VRGATE_VRGATE

config VRGATE_VRGATE_PROGNAME
	string "Program name"
	default "vrgate"
	---help---
		This is the name of the program that will be used when the NSH ELF
		program is installed.

config VRGATE_VRGATE_PRIORITY
	int "VRGATE_VRGATE task priority"
	default 100

config VRGATE_VRGATE_STACKSIZE
	int "VRGATE_VRGATE stack size"
	default DEFAULT_TASK_STACKSIZE

endif
```
